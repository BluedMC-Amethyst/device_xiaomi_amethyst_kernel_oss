/dts-v1/;
/plugin/;

/*
 * Amethyst Bluetooth/FM (WCN6750): QCOM volcano-bt.dtsi with board-id <0 0>.
 *
 * Stock carries the BT nodes (bt_wcn6750, bt_en_sleep, slimbus ngd@1
 * btfmslim, the HS UART and the RTC6226 FM node on SE7) in the base DTBs,
 * not in dtbo.img, so Xiaomi built this techpack with base IDs. With the
 * QCOM board-id list it would be merged into the board overlay instead.
 */

#include "volcano-bt.dtsi"

/ {
	qcom,msm-id = <636 0x10000>, <640 0x10000>, <641 0x10000>;
	qcom,board-id = <0 0>;
};
