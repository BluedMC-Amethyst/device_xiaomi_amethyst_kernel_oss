/dts-v1/;
/plugin/;

/*
 * Amethyst WLAN (WCN6750 via ICNSS2): QCOM volcano-qca6750.dtsi.
 *
 * Merged into the board overlay (stock dtbo.img entry 1, last fragment);
 * msm-ids limited to 636/640/641 like the other board techpacks.
 */

#include "volcano-qca6750.dtsi"

/ {
	qcom,msm-id = <636 0x10000>, <640 0x10000>, <641 0x10000>;
	qcom,board-id = <8 0>;
};
