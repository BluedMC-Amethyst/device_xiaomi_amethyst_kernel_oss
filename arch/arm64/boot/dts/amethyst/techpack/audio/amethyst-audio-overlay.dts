/dts-v1/;
/plugin/;

/*
 * Amethyst (Redmi Note 14 Pro+ 5G) board audio overlay.
 *
 * Xiaomi never published the audio-devicetree for this board. This overlay
 * is reconstructed from the stock dtbo.img (entry 1, fragments 36-45), where
 * merge_dtbs.py had merged it into the amethyst-sm7635 board overlay. The
 * QCOM volcano audio base (volcano-audio.dts) provides the nodes it
 * extends. The include order below is the stock fragment order.
 *
 * merge_dtbs.py merges it into the board overlay entry whose msm-id and
 * board-id it intersects; like every other board techpack it covers
 * Volcano/Volcano6/Volcano6P (636/640/641) only, which is why the stock
 * volcano6i entry (657/658) carries no audio.
 */

#include "amethyst-audio-lpi-pinctrl.dtsi"
#include "amethyst-audio-codec.dtsi"
#include "amethyst-audio-tlmm-pinctrl.dtsi"
#include "amethyst-audio-amp.dtsi"
#include "amethyst-haptics.dtsi"

/ {
	qcom,msm-id = <636 0x10000>, <640 0x10000>, <641 0x10000>;
	qcom,board-id = <8 0>;
};
